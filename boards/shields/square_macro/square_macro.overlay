#include <dt-bindings/zmk/matrix_transform.h>

/ {
    chosen {
        zmk,kscan = &kscan0;
    };

    kscan0: kscan_0 {
        compatible = "zmk,kscan-gpio-matrix";
        label = "KSCAN";
        diode-direction = "col2row";

        col-gpios
            = <&gpio0 5 (GPIO_ACTIVE_HIGH)>
            , <&gpio1 15 (GPIO_ACTIVE_HIGH)>
            , <&gpio1 14 (GPIO_ACTIVE_HIGH)>
            , <&gpio1 13 (GPIO_ACTIVE_HIGH)>
            ;

        row-gpios
            = <&gpio0 2 (GPIO_PULL_DOWN)>
            , <&gpio0 3 (GPIO_PULL_DOWN)>
            , <&gpio0 28 (GPIO_PULL_DOWN)>
            , <&gpio0 29 (GPIO_PULL_DOWN)>
            , <&gpio0 4 (GPIO_PULL_DOWN)>
            ;
    };
};